// SPDX-License-Identifier: (GPL-2.0+ OR MIT)
/*
 * Rithum Switch Pro (rsp): identical to rk3308-rithum-switch-pro-aarch32.dts,
 * for a trust.img with no BL32 - see rk3308-rithum-switch-no-optee.dtsi.
 */

/dts-v1/;

#include "rk3308-rithum-switch.dtsi"

/ {
	model = "Rithum Switch Pro";
	compatible = "rithum,switch-pro", "rockchip,rk3308";
};

#include "rk3308-rithum-switch-rsp.dtsi"
#include "rk3308-rithum-switch-no-optee.dtsi"
