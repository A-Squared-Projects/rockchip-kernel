// SPDX-License-Identifier: (GPL-2.0+ OR MIT)
/*
 * Rithum Switch Pro (rsp): 512MB RAM, USB RTL8152 Ethernet, RS485 on
 * uart0, audio populated.
 */

/dts-v1/;

#include "rk3308-rithum-switch.dtsi"

/ {
	model = "Rithum Switch Pro";
	compatible = "rithum,switch-pro", "rockchip,rk3308";
};

#include "rk3308-rithum-switch-rsp.dtsi"
