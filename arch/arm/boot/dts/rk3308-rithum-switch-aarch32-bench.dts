// SPDX-License-Identifier: (GPL-2.0+ OR MIT)
/*
 * Rithum Switch (rs), bench/development variant: identical to
 * rk3308-rithum-switch-aarch32.dts except the SD card slot runs in 1-bit
 * mode so the UART2-M1 debug console survives - see
 * rk3308-rithum-switch-bench.dtsi. Not for production: this trades away
 * the SD card's full 4-bit bus, which the sdcard-update feature needs.
 */

/dts-v1/;

#include "rk3308-rithum-switch.dtsi"

/ {
	model = "Rithum Switch";
	compatible = "rithum,switch", "rockchip,rk3308";
};

#include "rk3308-rithum-switch-rs.dtsi"
#include "rk3308-rithum-switch-bench.dtsi"
